## layers/meta-slow-bats/conf/layer.conf
```bitbake
BBPATH =. "${LAYERDIR}:"

BBFILE_COLLECTIONS += "slow-bats"
BBFILE_PATTERN_slow_bats = "^${LAYERDIR}/"
BBFILE_PRIORITY_slow_bats = "8"

LAYERVERSION_slow_bats = "1"
LAYERSERIES_COMPAT_slow_bats = "mickledore"
```
